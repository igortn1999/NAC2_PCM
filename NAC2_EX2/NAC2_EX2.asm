; 1. CABEÇALHO DE IDENTIFICAÇÃO

;FIAP
;PCM
;NAC 02 EX 2
;ALUNOS:
;IGOR TOMAZELLI NIETMANN - RM: 82808
;JAN PETER MERKEL 		 - RM: 81896

; 2. ARQUIVO DE DEFINIÇÃO DO MICROCONTROLADOR
#INCLUDE <P18F452.INC>

; 3. DEFINIÇÃO DE VARIÁVEIS
#DEFINE BOTAO_CIMA PORTB, 3
#DEFINE BOTAO_BAIXO PORTB, 4

#DEFINE LED_CIMA PORTD, 0
#DEFINE LED_BAIXO PORTD, 1
#DEFINE LED_VALVULA PORTD, 2

#DEFINE RECIP_CIMA RECIPIENTES_E_VALVULA, 0
#DEFINE RECIP_BAIXO RECIPIENTES_E_VALVULA, 1
#DEFINE VALVULA RECIPIENTES_E_VALVULA, 2

; 3.1 GERAIS

CBLOCK 0x80            ; ENDEREÇO INICIAL DA MEMÓRIA DE DADOS
    FILTRO_BOT         ; VARIÁVEL FILTRO PARA O BOTÃO
    RECIPIENTES_E_VALVULA		   ; VARIÁVEL QUE ENGLOBA O ESTADO DOS RECIPIENTES E DA VALVULA

ENDC

; 3.2 CONSTANTES

T_FILTRO EQU .255        ; CONSTANTE T_FILTRO COM 230 DECIMAL
ZERO EQU B'00000000'    ; CONSTANTE COM VALOR ZERO

; 4. VETOR DE RESET
ORG 0x00 
GOTO INICIO

; 5. INÍCIO DO PROGRAMA 
; CONFIGURAÇÕES INICIAIS (REGISTRADORES DE FUNÇÕES ;ESPECIAIS)
INICIO
    CLRF PORTD             ; LIMPA PORTD (ESCREVE ZERO EM TODOS OS PINOS DO PORTD)
	CLRF RECIPIENTES_E_VALVULA

    MOVLW B'00011000'     ; MOVE O VALOR BINÁRIO PARA O REGISTRADOR WORK 
    MOVWF TRISB         ; DEFINE RB3 E RB4 COMO ENTRADA E DEMAIS COMO SAÍDA
    MOVLW B'00000000'     ; MOVE O VALOR BINÁRIO PARA O REGISTRADOR WORK
    MOVWF TRISD         ; DEFINE TODOS OS TERMINAIS DO PORTD COMO SAÍDA
	
	BSF LED_CIMA 		; DEFINE COMPARTIMENTO DE CIMA COMO CHEIO NO INICIO
	BSF RECIP_CIMA
	
	BSF LED_BAIXO 		; DEFINE COMPARTIMENTO DE BAIXO COMO CHEIO NO INICIO
	BSF RECIP_BAIXO

	BCF LED_VALVULA 	; DEFINE A VALVULA PARA NÃO FUNCIONAR NO INICIO

; 6. FUNÇÃO PRINCIPAL
MAIN
	BTFSS RECIP_CIMA ;RECIPIENTE DE CIMA TEM AGUA?
	GOTO CIMA_SEM_AGUA;NÃO, RECIPIENTE SUPERIOR SEM AGUA
	GOTO CIMA_COM_AGUA;SIM,  RECIPIENTE SUPERIOR COM AGUA
	TESTA_BAIXO;TESTAR BOTAO DO RECPIENTE INFERIOR
	BTFSC RECIP_BAIXO ;RECIPIENTE DE BAIXO TEM AGUA?
	GOTO BAIXO_COM_AGUA;SIM,RECIPIENTE INFERIOR COM AGUA
	GOTO BAIXO_SEM_AGUA;NÃO,RECIPIENTE INFERIOR SEM AGUA		

	CIMA_SEM_AGUA
	BCF LED_CIMA
	;BCF RECIP_CIMA
	GOTO TESTA_BAIXO

	CIMA_COM_AGUA
	BSF LED_CIMA
	;BSF RECIP_CIMA
	GOTO TESTA_BAIXO
	
	BAIXO_SEM_AGUA
	BCF LED_BAIXO
	;BCF RECIP_BAIXO
	GOTO VERIFICA_VALVULA

	BAIXO_COM_AGUA
	BSF LED_BAIXO
	;BSF RECIP_BAIXO
	GOTO VERIFICA_VALVULA

	VERIFICA_VALVULA; CIMA=1, BAIXO =0
	BTFSS RECIP_CIMA;RECIPIENTE DE CIMA ESTÁ CHEIO?
	GOTO DESLIGA_VALVULA;NÃO
	;SIM
	BTFSC RECIP_BAIXO;RECIPIENTE DE BAIXO ESTA CHEIO?
	GOTO DESLIGA_VALVULA;SIM
	;NÃO
	LIGA_VALVULA	
	BSF VALVULA
	BSF LED_VALVULA
	GOTO TESTE_BOTOES
	
	DESLIGA_VALVULA
	BCF VALVULA
	BCF LED_VALVULA
	GOTO TESTE_BOTOES	

	TESTE_BOTOES
	MOVLW T_FILTRO
	MOVWF FILTRO_BOT
	PRIMEIRO_BOTAO
	BTFSC BOTAO_CIMA;BOTAO DE CIMA ESTA PRESSIONADO?
	GOTO PROXIMO_BOTAO;NÃO ESTÁ PRESSIONADO
	DECFSZ FILTRO_BOT, 1;ESTÁ PRESSIOANDO
	GOTO PRIMEIRO_BOTAO
	;REALMENTE ESTÁ PRESSIONADO
	PRENDE_BOTAO
	BTFSS BOTAO_CIMA;BOTAO DE CIMA ESTA PRESSIONADO?
	GOTO PRENDE_BOTAO;0 = SIM, CONTINUE TRAVADO
	;1=NÃO, PODE CONTINUAR
	BTFSS RECIP_CIMA	
	GOTO CIMA_VAZIO
	BCF RECIP_CIMA
	GOTO PROXIMO_BOTAO
	CIMA_VAZIO
	BSF RECIP_CIMA
	
	PROXIMO_BOTAO
	MOVLW T_FILTRO
	MOVWF FILTRO_BOT
	SEGUNDO_FILTRO_BOT	
	BTFSC BOTAO_BAIXO
	GOTO MAIN;NÃO ESTÁ PRESSIONADO
	DECFSZ FILTRO_BOT, 1;ESTÁ PRESSIOANDO
	GOTO SEGUNDO_FILTRO_BOT
	;REALMENTE ESTÁ PRESSIONADO
	PRENDE_BOTAO2
	BTFSS BOTAO_CIMA;BOTAO DE CIMA ESTA PRESSIONADO?
	GOTO PRENDE_BOTAO2;0 = SIM, CONTINUE TRAVADO
	;1=NÃO, PODE CONTINUAR
	BTFSS RECIP_BAIXO
	GOTO BAIXO_VAZIO
	BCF RECIP_BAIXO
	GOTO MAIN
	BAIXO_VAZIO
	BSF RECIP_CIMA
	GOTO MAIN
END